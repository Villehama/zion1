## boards/shields/zion01/Kconfig.defconfig
```kconfig
if SHIELD_ZION01_RIGHT

config ZMK_KEYBOARD_NAME
    default "zion01"

endif

if SHIELD_ZION01_LEFT || SHIELD_ZION01_RIGHT

config ZMK_SPLIT
    default y

endif
```

## boards/shields/zion01/Kconfig.shield
```kconfig
config SHIELD_ZION01_LEFT
    def_bool $(shields_list_contains,zion01_left)
config SHIELD_ZION01_RIGHT
    def_bool $(shields_list_contains,zion01_right)
```
